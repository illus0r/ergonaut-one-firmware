## config/west.yml
```yaml
manifest:
  remotes:
    - name: zmkfirmware
      url-base: https://github.com/zmkfirmware
  projects:
    - name: zmk
      remote: zmkfirmware
      revision: 3f7c9d7cc4f46617faad288421025ea2a6b0bd28
      import: app/west.yml
  self:
    path: config
```
